## components/bsec/Kconfig
```kconfig
menu "BSEC Library Configuration"

    config BME680_ENABLED
        bool "Enable BME680/BME688 support (requires BSEC library)"
        default n
        help
            Enable support for BME680/BME688 environmental sensors using
            Bosch BSEC 2.x library.

            This requires the proprietary BSEC library to be installed.
            See components/bsec/README.md for setup instructions.

            If disabled, the firmware will only support ambient light sensors
            (VEML7700/OPT4001) and will build without BSEC dependencies.

    config BME680_I2C_ADDR
        hex "BME680 I2C Address"
        depends on BME680_ENABLED
        default 0x76
        range 0x76 0x77
        help
            I2C address of the BME680/BME688 sensor.

            Default: 0x76 (SDO pin low)
            Alternate: 0x77 (SDO pin high)

    config BME680_SAMPLE_RATE
        int "BME680 Sample Rate (seconds)"
        depends on BME680_ENABLED
        default 3
        range 1 60
        help
            How often to read the BME680 sensor (in seconds).

            Recommended: 3 seconds (balances accuracy with power consumption)
            BSEC requires regular sampling for accurate air quality calculation.

    config BME680_SAVE_STATE_INTERVAL
        int "BSEC State Save Interval (hours)"
        depends on BME680_ENABLED
        default 4
        range 1 24
        help
            How often to save BSEC calibration state to NVS (in hours).

            BSEC learns air quality baselines over time. Saving state
            preserves calibration across reboots.

            Recommended: 4 hours (balances wear leveling with state freshness)

endmenu
```

## sdkconfig.defaults.factory
```kconfig
# sdkconfig.defaults.factory - Minimal FACTORY firmware
# Used with: ./build.sh --type=factory
# Target size: < 256KB (current: ~190KB)

# Partition table (same as main)
CONFIG_PARTITION_TABLE_CUSTOM=y
CONFIG_PARTITION_TABLE_CUSTOM_FILENAME="partitions.csv"
CONFIG_ESPTOOLPY_FLASHSIZE_4MB=y

# DISABLE sensors for factory build
CONFIG_BME680_ENABLED=n

# Size optimization (critical for minimal size)
CONFIG_COMPILER_OPTIMIZATION_SIZE=y

# Use newlib nano (smaller C library)
CONFIG_NEWLIB_NANO_FORMAT=y

# Logging - WARN level to reduce binary size
CONFIG_LOG_DEFAULT_LEVEL_WARN=y
CONFIG_BOOTLOADER_LOG_LEVEL_WARN=y

# FreeRTOS tick rate
CONFIG_FREERTOS_HZ=100

# Reduce stack sizes where safe
CONFIG_ESP_MAIN_TASK_STACK_SIZE=3072
CONFIG_FREERTOS_IDLE_TASK_STACKSIZE=1024

# Disable unused features for smaller binary
CONFIG_ESP_ERR_TO_NAME_LOOKUP=n
CONFIG_ESP_SYSTEM_PANIC_PRINT_HALT=y
```

## sdkconfig.defaults.main
```kconfig
# sdkconfig.defaults.main - Full-featured MAIN firmware
# Used with: ./build.sh --type=main

# Partition table
CONFIG_PARTITION_TABLE_CUSTOM=y
CONFIG_PARTITION_TABLE_CUSTOM_FILENAME="partitions.csv"
CONFIG_ESPTOOLPY_FLASHSIZE_4MB=y

# Enable all sensors
CONFIG_BME680_ENABLED=y

# Performance optimization (MAIN has plenty of space)
CONFIG_COMPILER_OPTIMIZATION_PERF=y

# Logging - INFO level for debugging
CONFIG_LOG_DEFAULT_LEVEL_INFO=y

# FreeRTOS tick rate
CONFIG_FREERTOS_HZ=100
```
